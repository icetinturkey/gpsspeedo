#include <SPI.h>
#include <Wire.h>
#include <SoftwareSerial.h>
#include <Adafruit_GFX.h>
#include <Adafruit_SSD1306.h>
Adafruit_SSD1306 display(128, 64, &Wire, 4);
SoftwareSerial ss(2, 3);
#include <TinyGPS++.h>
TinyGPSPlus gps;
bool veriGeldi;
static const unsigned char PROGMEM logo_bmp[] =
{ 0x00, 0x00, 0x00, 0x00, 0x00, 0x00, 0x00, 0x00, 0x00, 0x00, 0x00, 0x00, 0x00, 0x00, 0x00, 0x00, 
0x00, 0x00, 0x03, 0xff, 0xff, 0xcf, 0x03, 0xe0, 0x00, 0x00, 0x00, 0x00, 0x00, 0x00, 0x00, 0x00, 
0x00, 0x00, 0x7f, 0xff, 0xff, 0x8f, 0x07, 0xc0, 0x00, 0x00, 0x00, 0x00, 0x00, 0x00, 0x00, 0x00, 
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0x00, 0x00, 0x00, 0x00, 0x00, 0x00, 0x00, 0x00, 0x00, 0x00, 0x00, 0x00, 0x00, 0x00, 0x00, 0x00 };
void setup() {
  display.begin(SSD1306_SWITCHCAPVCC, 0x3C);
  display.clearDisplay();
  display.drawBitmap(0,16,logo_bmp,128,37,1);
  display.display();
  display.setTextColor(SSD1306_WHITE);
  veriGeldi=false;
  ss.begin(9600);
}

void loop() {
while (ss.available() > 0)
    if (gps.encode(ss.read()))
      displayInfo();
}

void displayInfo()
{
  display.clearDisplay();

  if (gps.time.isValid())
  {
    String saat;
    int d1 = gps.time.hour();
    int d2 = gps.time.minute();
    if(d1+3>23){
    if(d1==21)
      d1=0;
    else if(d1==22)
      d1=1;
    else
      d1=2;}else d1+=3;
    if(d1<10)
      if(d2<10)
        saat="0"+(String)d1+":0"+(String)d2;
      else
        saat="0"+(String)d1+":"+(String)d2;
    else
      if(d2<10)
        saat=(String)d1+":0"+(String)d2;
      else
        saat=(String)d1+":"+(String)d2;
    char _saatDeger[7];
    saat.toCharArray(_saatDeger, 6);
    display.setTextSize(1);
    display.setCursor(4, 0);
    display.write(_saatDeger);

    smartDelay(0);
  }
if (gps.satellites.isValid())
  {
    String uydu=(String)gps.satellites.value();
    char _uyduDeger[4];
    uydu.toCharArray(_uyduDeger,3);
    display.setTextSize(1);
  display.setCursor(85, 0);
    display.write("Uydu; ");
    display.write(_uyduDeger);
    smartDelay(0);
  }
  
  if (gps.speed.isValid())
  {
    int _hiz = (int)gps.speed.kmph();
    if(_hiz>=0)
      veriGeldi=true;
    String hiz=(String)_hiz;
    char _hizDeger[5];
    hiz.toCharArray(_hizDeger,4);
    display.setTextSize(4);
    if(_hiz<100)
      if(_hiz<10)
        display.setCursor(55, 32);
      else
        display.setCursor(43, 32);
    else
      display.setCursor(30, 32);
    display.write(_hizDeger);
    smartDelay(0);
  }

  if(veriGeldi)
    display.display();
  smartDelay(1000);
}
static void smartDelay(unsigned long ms)
{
  unsigned long start = millis();
  do 
  {
    while (ss.available())
      gps.encode(ss.read());
  } while (millis() - start < ms);
}
